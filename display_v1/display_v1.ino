
#include <LedControl.h>

const int numDevices = 1;
const long scrollDelay = 120;
unsigned long bufferLong [14] = {0};
LedControl lc=LedControl(12,11,10,numDevices);//12=1,11=13,10=12

int flag=1; //1 for scrolling, 0 for static

const unsigned char initialText[] PROGMEM ={"@_utkal   "};


const unsigned char font5x7 [] PROGMEM = {
    B00000000,	//Space (Char 0x20)
    B00000000,
    B00000000,
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    B00011000,
    5
};



void setup(){
  Serial.begin(9600);
  for (int x=0; x<numDevices; x++){
    lc.shutdown(x,false);       //The MAX72XX is in power-saving mode on startup
    lc.setIntensity(x,10);       // Set the brightness to default value
    lc.clearDisplay(x);         // and clear the display
    }
}

void loop(){
  scrollMessage(initialText);
}

void scrollMessage(const unsigned char * messageString) {
    int counter = 0;
    int myChar=0;
    do {
        myChar =  pgm_read_byte_near(messageString + counter);
        if (myChar != 0){
            loadBufferLong(myChar);
        }
        counter++;
    }
    while (myChar != 0);
    if (flag==0){       //static
      printBufferLong();}
}

void loadBufferLong(int ascii){
    if (ascii >= 0x20 && ascii <=0x7f){
        for (int a=0;a<7;a++){
            unsigned long c = pgm_read_byte_near(font5x7 + ((ascii - 0x20) * 8) + a);
            unsigned long x = bufferLong [a*2];
            x = x | c;
            bufferLong [a*2] = x;
        }
        byte count = pgm_read_byte_near(font5x7 +((ascii - 0x20) * 8) + 7);
        for (byte x=0; x<count;x++){
            rotateBufferLong();
            if (flag==1){     //scroll
            printBufferLong();}
            delay(scrollDelay);
        }
    }
}

void rotateBufferLong(){
    for (int a=0;a<7;a++){
        unsigned long x = bufferLong [a*2];
        byte b = bitRead(x,31);
        x = x<<1;
        bufferLong [a*2] = x;
        x = bufferLong [a*2+1];
        x = x<<1;
        bitWrite(x,0,b);
        bufferLong [a*2+1] = x;
    }
}

void printBufferLong(){
  for (int a=0;a<7;a++){
    unsigned long x = bufferLong [a*2+1];
    byte y = x;
    lc.setRow(3,a,y);
    x = bufferLong [a*2];
    y = (x>>24);
    lc.setRow(2,a,y);
    y = (x>>16);
    lc.setRow(1,a,y);
    y = (x>>8);
    lc.setRow(0,a,y);
  }
}
